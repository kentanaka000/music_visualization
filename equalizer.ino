#include <arduinoFFT.h>
#include <FastLED.h>

//FFT constants
#define SAMPLES 64//Must be a power of 2
#define SAMPLING_FREQUENCY 2000 //Hz, must be less than 10000 due to ADC
#define SAMPLE_PIN 5

//LED constants
#define LED_PIN     3
#define N 27
#define NUM_LEDS    N*N
#define BRIGHTNESS  50
#define LED_TYPE    WS2811
#define COLOR_ORDER GRB

//LED vars
CRGB leds[NUM_LEDS];
CRGB off[NUM_LEDS];
int brightness = 32;
int dimPeriod = 10;
unsigned long dimTimer;


//FFT vars
arduinoFFT FFT = arduinoFFT();

unsigned long sampling_period_us;
unsigned long microseconds;

double vReal[SAMPLES];
double vImag[SAMPLES];


//vars for sound detection
double prevReal[SAMPLES];
double baseAvg;
double prevBase;
int baseCount;
double midAvg;
double midPrevAvg;
int midCount;
double highAvg;
double highPrevAvg;
int highCount;

//designs
CRGB designA[NUM_LEDS] = {CRGB::Red, CRGB::White, CRGB::Red, CRGB::White,CRGB::Red, CRGB::White,CRGB::Red, CRGB::White, CRGB::Red} ;
CRGB designB[NUM_LEDS] = {CRGB::Red, CRGB::Orange, CRGB::Yellow, CRGB::Green, CRGB::Blue, CRGB::Purple, CRGB::Red, CRGB::Orange, CRGB::Yellow};
CRGB designC[NUM_LEDS] = {CRGB::White,CRGB::White,CRGB::White,CRGB::White,CRGB::White,CRGB::White,CRGB::White,CRGB::White,CRGB::White};


int indexFromCoord(int x, int y) {
  if (y%2==0) {
    return y * 27 +  (27 - x - 1);
  }
  else {
    return y * 27 + x;
  };


}

void setup() {
    Serial.begin(115200);
    sampling_period_us = round(1000000*(1.0/SAMPLING_FREQUENCY));


    delay( 3000 ); // power-up safety delay
    FastLED.addLeds<LED_TYPE, LED_PIN, COLOR_ORDER>(leds, NUM_LEDS).setCorrection( TypicalLEDStrip );
    FastLED.setBrightness(  BRIGHTNESS );

    dimTimer = millis();
}


void loop() {

    /*SAMPLING*/
    for(int i=0; i<SAMPLES; i++)
    {
        microseconds = micros();    //Overflows after around 70 minutes!

        vReal[i] = analogRead(SAMPLE_PIN);
        vImag[i] = 0;

//        timedDim();

        while(micros() < (microseconds + sampling_period_us)){
        }
    }

    /*FFT*/
    FFT.Windowing(vReal, SAMPLES, FFT_WIN_TYP_HAMMING, FFT_FORWARD);
    FFT.Compute(vReal, vImag, SAMPLES, FFT_FORWARD);
    FFT.ComplexToMagnitude(vReal, vImag, SAMPLES);
    double peak = FFT.MajorPeak(vReal, SAMPLES, SAMPLING_FREQUENCY);
    int peakBin = (int)peak * SAMPLES / SAMPLING_FREQUENCY;


    CRGB arr[N] = {CRGB::Green, CRGB::Red, CRGB::Blue, CRGB::Yellow, CRGB::Purple, CRGB::Orange, CRGB::Blue, CRGB::Orange,CRGB::Green, CRGB::Red, CRGB::Blue, CRGB::Yellow, CRGB::Purple, CRGB::Orange, CRGB::Blue, CRGB::Orange,CRGB::Green, CRGB::Red, CRGB::Blue, CRGB::Yellow, CRGB::Purple, CRGB::Orange, CRGB::Blue, CRGB::Orange};


 double mx = 1500;
 //for (int i = 0; i < N; i++) { mx = max(mx, vReal[i+2]); }
 for (int i = 0; i < N; i++) {
   CRGB color = arr[i];
   double val = vReal[i+2];
   int bars = int(27 * val / mx);
   for (int z = 0; z < N; z++){
    if (z < bars){
      leds[indexFromCoord(i, z)] = color;
     } else {
      leds[indexFromCoord(i, z)] = 0;
     }

   }
 }

//   for (int i = 0; i < 27 * 27; i++) leds[i] = CRGB::Red;

//patternX();
FastLED.show();
}



void timedDim() {
  if (millis() - dimTimer > dimPeriod && brightness > 0) {
    brightness --;

    FastLED.setBrightness(  brightness );
    FastLED.show();
    dimTimer = millis();

  }
}

void patternX() {
  const int totalNum = 729;
  CRGB design[totalNum] = {0x000000, 0x000000, 0x000000, 0x000000, 0x000000, 0x000000, 0x000000, 0x000000, 0x000000, 0x000000, 0x000000, 0x000000, 0x000000,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 0x000000, 0x000000};
  for (int i = 0; i < totalNum;i++) {
    leds[i] = design[i];
  }
  brightness = BRIGHTNESS;
}
